/*------------------------------------------------* 
# # Copyright (c) 2026 Advanced Micro Devices, Inc.
# # SPDX-License-Identifier: MIT
# # -----------------------------------------------*/

&amba_pl {
	/delete-node/ i2c@80000000;
	/delete-node/ i2c@80010000;
	/delete-node/ i2c@80020000;
	/delete-node/ mipi_csi2_rx_subsystem@b0020000;
	/delete-node/ mipi_csi2_rx_subsystem@b0022000;
	/delete-node/ mipi_csi2_rx_subsystem@b0024000;
	/delete-node/ mipi_csi2_rx_subsystem@b0026000;
	/delete-node/ mipi_csi2_rx_subsystem@b0028000;
	/delete-node/ mipi_csi2_rx_subsystem@b002a000;
	/delete-node/ axis_broadcastermipi_rx_ss_hier_axis_broadcaster_0@0;
	/delete-node/ axis_broadcastermipi_rx_ss_hier_axis_broadcaster_1@0;
	/delete-node/ axis_broadcastermipi_rx_ss_hier_axis_broadcaster_2@0;
	/delete-node/ axis_broadcastermipi_rx_ss_hier_axis_broadcaster_3@0;
	/delete-node/ axis_broadcastermipi_rx_ss_hier_axis_broadcaster_4@0;
	/delete-node/ axis_broadcastermipi_rx_ss_hier_axis_broadcaster_5@0;
	
};
